## boards/shields/rev45lp/Kconfig.defconfig
```kconfig
if SHIELD_REV45LP

config ZMK_KEYBOARD_NAME
    default "rev45lp"

endif # SHIELD_REV45LP
```

## zephyr/Kconfig
```kconfig
# Custom firmware features for this keyboard.
# Enable and tune them in config/rev57lp.conf.

menuconfig RGB_BATTERY_STATUS
    bool "Show battery level by blinking the underglow"
    depends on ZMK_RGB_UNDERGLOW && ZMK_BATTERY_REPORTING
    help
      Every RGB_BATTERY_STATUS_INTERVAL_SEC seconds, blink the underglow
      with the colour pattern of the current battery level, then restore
      the previous on/off state, effect and colour. The levels and their
      colours are the table at the top of src/rgb_battery_status.c.

if RGB_BATTERY_STATUS

config RGB_BATTERY_STATUS_INTERVAL_SEC
    int "Seconds between battery checks"
    range 10 86400
    default 600

config RGB_BATTERY_STATUS_BLINK_MS
    int "Duration of each on and each off phase, in milliseconds"
    range 50 2000
    default 300

config RGB_BATTERY_STATUS_BRIGHTNESS
    int "Blink brightness, in percent"
    range 1 100
    default 100

config RGB_BATTERY_STATUS_DEMO
    bool "Demo: show every level in turn instead of the real battery level"
    help
      Each check shows the next level of the table, ignoring the real
      charge. Combine with a short interval to try out the colours.

endif

menuconfig RGB_CAPS_INDICATOR
    bool "Show Caps Lock and Caps Word on the underglow"
    depends on ZMK_RGB_UNDERGLOW
    help
      While Caps Lock or Caps Word is on, light the whole underglow in one
      colour. When both are off, restore the previous on/off state, effect
      and colour.

if RGB_CAPS_INDICATOR

config RGB_CAPS_INDICATOR_CAPS_LOCK
    bool "React to the computer's Caps Lock"
    default y
    select ZMK_HID_INDICATORS

config RGB_CAPS_INDICATOR_CAPS_WORD
    bool "React to Caps Word (&caps_word)"
    default y

config RGB_CAPS_INDICATOR_HUE
    int "Colour hue (180 = cyan, 0 = red, 120 = green, 240 = blue)"
    range 0 359
    default 180

config RGB_CAPS_INDICATOR_BRIGHTNESS
    int "Colour brightness, in percent"
    range 1 100
    default 100

endif
```
